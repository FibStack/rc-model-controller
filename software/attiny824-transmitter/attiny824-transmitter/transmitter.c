/*
* Copyright (c) 2023, FibStack
* All rights reserved.
*
* This source code is licensed under the MIT license found in the
* LICENSE file in the root directory of this source tree.
*/

#include "transmitter.h"

uint8_t switch_state = 0;
uint8_t adc_muxpos[ADC_CHANNELS] = {ADC_MUXPOS_AIN1_gc, ADC_MUXPOS_AIN2_gc};
uint8_t adc_channel = 0;
uint8_t throttle = 0;
uint8_t steering = 0;

void USART0_init()
{
	PORTB.DIR |= PIN2_bm; // Set pin 7 as output
	USART0.BAUD = (uint16_t)USART0_BAUD_RATE(4800);
	USART0.CTRLB |= USART_TXEN_bm; // Enable transmission
}

void USART0_sendByte(uint8_t byte)
{
	while(!(USART0.STATUS & USART_DREIF_bm))
	{
		;// wait for previous transmission to complete
	}
	USART0.TXDATAL = byte;
}

void PORTA_init()
{
	PORTA.DIR &= ~(PIN4_bm | PIN5_bm | PIN6_bm | PIN7_bm);
	PORTA.PIN4CTRL = PORT_ISC_BOTHEDGES_gc;
	PORTA.PIN5CTRL = PORT_ISC_BOTHEDGES_gc;
	PORTA.PIN6CTRL = PORT_ISC_BOTHEDGES_gc;
	PORTA.PIN7CTRL = PORT_ISC_BOTHEDGES_gc;
}

void ADC0_init()
{
	// Disable digital input buffer PA1 (pin 11), Throttle
	PORTA.PIN1CTRL &= ~PORT_ISC_gm;
	PORTA.PIN1CTRL |= PORT_ISC_INPUT_DISABLE_gc;

	// Disable digital input buffer PA2 (pin 12), Steering
	PORTA.PIN2CTRL &= ~PORT_ISC_gm;
	PORTA.PIN2CTRL |= PORT_ISC_INPUT_DISABLE_gc;
	
	// Disable pull-up resistor
	PORTA.PIN1CTRL &= ~PORT_PULLUPEN_bm;
	PORTA.PIN2CTRL &= ~PORT_PULLUPEN_bm;
	
	ADC0.COMMAND = ADC_MODE_SINGLE_8BIT_gc;
	
	ADC0.CTRLC = ADC_PRESC_DIV4_gc		// CKL_PER divided by 4
	| ADC_REFSEL_VDD_gc; // VDD reference

	ADC0.CTRLA |= ADC_ENABLE_bm; // Enable ADC
	ADC0.MUXPOS = adc_muxpos[adc_channel]; // Select first channel

	ADC0.INTCTRL |= ADC_RESRDY_bm; // Enable Result Ready interrupt
}

void ADC0_start()
{
	ADC0.COMMAND |= ADC_START_IMMEDIATE_gc; // Start conversion
}

void ADC0_clear_interrupt_flag()
{
	ADC0.INTFLAGS = ADC_RESRDY_bm; // Clear the ADC Result Ready interrupt flag by writing 1
}

void ADC0_process()
{
	ADC0_clear_interrupt_flag();
	
	switch(adc_channel) {
		case 0:
		throttle = ADC_adjust_value(ADC0.SAMPLEL);
		break;
		case 1:
		steering = ADC_adjust_value(ADC0.SAMPLEL);
		break;
		default:
		break;
	}

	// Move to next channel
	adc_channel = (adc_channel + 1) % ADC_CHANNELS;
	ADC0.MUXPOS = adc_muxpos[adc_channel];
	
	ADC0_start();
}

uint8_t ADC_adjust_value(uint8_t value)
{
	uint8_t result = value - 0x7F;
	if (result > 0x7F) {
		result = 0xFF - result;
	}
	return result * 2;
}

uint8_t crc8_table[256] = {
	0x00,0x31,0x62,0x53,0xC4,0xF5,0xA6,0x97,0xB9,0x88,0xDB,0xEA,0x7D,0x4C,0x1F,0x2E,
	0x43,0x72,0x21,0x10,0x87,0xB6,0xE5,0xD4,0xFA,0xCB,0x98,0xA9,0x3E,0x0F,0x5C,0x6D,
	0x86,0xB7,0xE4,0xD5,0x42,0x73,0x20,0x11,0x3F,0x0E,0x5D,0x6C,0xFB,0xCA,0x99,0xA8,
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0x82,0xB3,0xE0,0xD1,0x46,0x77,0x24,0x15,0x3B,0x0A,0x59,0x68,0xFF,0xCE,0x9D,0xAC };

uint8_t crc_8(uint8_t *data, uint8_t len)
{
	uint8_t crc = 0xFF;
	for (uint8_t i = 0; i < len; i++) {
		crc = crc8_table[data[i] ^ crc];
	}
	return crc;
}